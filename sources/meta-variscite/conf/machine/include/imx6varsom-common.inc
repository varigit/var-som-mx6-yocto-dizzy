## sources/meta-variscite/conf/machine/include/imx6varsom-common.inc
```bitbake
# Provides the i.MX6 VAR-SOM-MX6 common settings

require conf/machine/include/var-imx-base.inc
require conf/machine/include/tune-cortexa9.inc

SERIAL_CONSOLE = "115200 ttymxc0"

#MACHINE_FIRMWARE_append_mx6 = " linux-firmware-wl12xx"
#MACHINE_FIRMWARE_append_mx6 = " wl18xx-firmware"

MACHINE_FEATURES += " pci bluetooth touchscreen wifi"
```

## sources/meta-variscite/conf/machine/include/var-1GB-ubi.inc
```bitbake
#
# UBIFS for Variscite NAND 1.0 GB
#
UBI_ROOT_FS_NAME = "[rootfs]"
UBI_VOLNAME  = "rootfs"
MKUBIFS_ARGS = " -m 2048 -e 124KiB -c 7855 "
UBINIZE_ARGS = " -m 2048 -p 128KiB -s 2048 -O 2048 "
#
```

## sources/meta-variscite/conf/machine/include/var-2gb-ubi.inc
```bitbake
#
# UBIFS for Variscite NAND 2.0 GB
#
UBI_ROOT_FS_NAME = "[rootfs]"
UBI_VOLNAME  = "rootfs"
MKUBIFS_ARGS = " -m 2048 -e 124KiB -c 15800 "
UBINIZE_ARGS = " -m 2048 -p 128KiB -s 2048 -O 2048 "
#
```

## sources/meta-variscite/conf/machine/include/var-512MB-ubi.inc
```bitbake
#
# UBIFS for Variscite NAND 0.5 GB
#
UBI_ROOT_FS_NAME = "[rootfs]"
UBI_VOLNAME  = "rootfs"
MKUBIFS_ARGS = " -m 2048 -e 124KiB -c 3965 "
UBINIZE_ARGS = " -m 2048 -p 128KiB -s 2048 -O 2048 "
#
```

## sources/meta-variscite/conf/machine/include/var-default-providers.inc
```bitbake
# Variscite BSP default providers

PREFERRED_PROVIDER_virtual/xserver = "xserver-xorg"
PREFERRED_PROVIDER_u-boot = "u-boot-imx-variscite"
PREFERRED_PROVIDER_virtual/kernel_mx6 = "linux-variscite"
PREFERRED_PROVIDER_u-boot ?= "u-boot-fslc"
PREFERRED_PROVIDER_virtual/bootloader ?= "u-boot-fslc"

PREFERRED_PROVIDER_wpa-supplicant-cli = "wpa-supplicant-wl18xx"
PREFERRED_PROVIDER_wpa-supplicant-passphrase = "wpa-supplicant-wl18xx"
PREFERRED_PROVIDER_wpa-supplicant = "wpa-supplicant-wl18xx"
```

## sources/meta-variscite/conf/machine/varsomimx6.conf
```bitbake
#@TYPE: Machine
#@NAME: Variscite i.MX6Q VAR-SOM-MX6
#@SOC: i.MX6Q
#@DESCRIPTION: Machine configuration for Variscite i.MX6Q VAR-SOM-MX6

require conf/machine/include/imx6varsom-common.inc
include conf/machine/include/var-512MB-ubi.inc

SOC_FAMILY = "mx6:mx6q"

PREFERRED_PROVIDER_u-boot = "u-boot-imx-variscite"
PREFERRED_PROVIDER_u-boot_mx6 = "u-boot-imx-variscite"

KERNEL_DEVICETREE = "imx6q-var-som.dtb imx6dl-var-som.dtb imx6dl-var-som-solo-vsc.dtb"

UBOOT_SUFFIX_SDCARD = "img"
UBOOT_SPL_BUILD     = "yes"


UBOOT_CONFIG ??= "sd"
#UBOOT_CONFIG ??= "nand"
#
UBOOT_CONFIG[sd] = "mx6var_som_sd_config,sdcard"
UBOOT_CONFIG[nand] = "mx6var_som_nand_config,ubifs"
#
```
